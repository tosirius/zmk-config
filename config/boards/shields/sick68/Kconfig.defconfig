## config/boards/shields/sick68/Kconfig.defconfig
```kconfig
# Copyright (c) 2020 The ZMK Contributors
# SPDX-License-Identifier: MIT

if SHIELD_SICK68

config ZMK_KEYBOARD_NAME
    default "Sick68"

endif
```

## config/boards/shields/sick68/Kconfig.shield
```kconfig
# Copyright (c) 2020 The ZMK Contributors
# SPDX-License-Identifier: MIT

config SHIELD_SICK68
    def_bool $(shields_list_contains,sick68)
```
